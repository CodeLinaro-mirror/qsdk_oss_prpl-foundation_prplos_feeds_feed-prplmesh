## services/pwhm/Config.in
```kconfig
config PACKAGE_pwhm
    tristate
    select SAH_SERVICES_PWHM

if PACKAGE_pwhm

menu "Select pwhm build options"
    depends on PACKAGE_pwhm

config SAH_SERVICES_PWHM
    bool "Build pwhm itself"
    default y

config SAH_SERVICES_PWHM_DISABLE_PERSIST
    bool "PWHM shall disable doing own persistence"
    default n

config SAH_SERVICES_PWHM_DISABLE_NETMODEL
    bool "Disable integrating PWHM with netmodel"
    default n

config USE_SAH_WPS_FORCE_EQUAL_WL_UUID
    bool "Create WPS UUID based AP MAC address"
    default n

config USE_SAH_WPS_DEVICE_NAME
    bool "Force a WPS custom device name in WPS IE"
    default n

config SAH_WPS_DEVICE_NAME
    string "WPS IE device Name string"
    default "SAH_WPS_DeviceName"
    depends on USE_SAH_WPS_DEVICE_NAME

config USE_SAH_WPS_FRIENDLY_NAME
    bool "Force a WPS custom friendly name in WPS IE"
    default n

config SAH_WPS_FRIENDLY_NAME
    string "WPS IE Friendly Name string"
    default "SAH_WPS_FriendlyName"
    depends on USE_SAH_WPS_FRIENDLY_NAME

config SAH_WLD_INIT_LEGACY
    bool "Legacy: Init wld from vendor plugin"
    default n
    depends on SAH_LIB_WLD

config SAH_WLD_INIT_SCRIPT
    string "Generic plugin init script name"
    default "wld_gen"
    depends on !SAH_WLD_INIT_LEGACY

config SAH_WLD_INIT_ORDER
    int "Generic plugin init order"
    default 60
    depends on !SAH_WLD_INIT_LEGACY

config SAH_WLD_ENABLE_USP_SERVER_SOCKET
    bool "Enable direct USP server socket"
    default n
    depends on PACKAGE_mod-amxb-usp

config SAH_WLD_ENABLE_PCB_SERVER_SOCKET
    bool "Enable direct PCB server socket"
    default n
    depends on (PACKAGE_mod-amxb-pcb || SAH_MOD_AMXB_PCB)

config SAH_WLD_ROOT_OBJ_PREFIX
    string "DataModel Root Object Prefix"
    default "Device."
    depends on SAH_WLD_ENABLE_USP_SERVER_SOCKET

endmenu

endif
```

## services/wifi-sensing/Config.in
```kconfig
config PACKAGE_wifi-sensing
    tristate
    select SAH_SERVICES_SENSING

if PACKAGE_wifi-sensing

menu "Select wifi-sensing build options"
    depends on PACKAGE_wifi-sensing

config SAH_SERVICES_SENSING
    bool "Build wifi sensing itself"
    default y

config SAH_SERVICES_SENSING_START_ORDER
    int "Start up order"
    default 98

config SAH_SERVICES_SENSING_STOP_ORDER
    int "Stop order"
    default 1

config SAH_SERVICES_SENSING_PROCESS_MANAGER
    bool "Disable autostart in WiFi-Sensing when Process Manager enabled"
    default y
    depends on PACKAGE_prplmesh-process-manager

config SAH_SERVICES_SENSING_AMX_PROCESSMONITOR
    bool "Install AMX ProcessMonitor files when component enabled"
    default y
    depends on (SAH_AMX_PROCESSMONITOR || PACKAGE_amx-processmonitor)

config SAH_SERVICES_SENSING_DATAMODEL_MAPPER
    bool "Enable prplMesh DataModel Mapper connection"
    default y
    depends on PACKAGE_prplmesh-dm-mapper

endmenu

endif
```
